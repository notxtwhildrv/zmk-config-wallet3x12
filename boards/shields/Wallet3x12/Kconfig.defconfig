## boards/shields/Wallet3x12/Kconfig.defconfig
```kconfig
# Copyright (c) 2021 The ZMK Contributors
# SPDX-License-Identifier: MIT

if SHIELD_WALLET3X12

config ZMK_KEYBOARD_NAME
    default "wallet3x12"

endif
```

## boards/shields/Wallet3x12/kconfig.shield
```kconfig
# Copyright (c) 2021 The ZMK Contributors
# SPDX-License-Identifier: MIT

config SHIELD_WALLET3X12
    def_bool $(shields_list_contains,wallet3x12)
```
